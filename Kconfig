## Kconfig
```kconfig
module = MY_MODULE_BASE
module-str = my module base
source "subsys/logging/Kconfig.template.log_config"

config MY_MODULE_BASE_RESET
	bool "Reset support"
	select HWINFO

config MY_MODULE_BASE_UID
	bool "Unique ID support"
	select HWINFO

config LOG_FUNC_NAME_PREFIX_DBG
	default n

rsource "Kconfig.openthread"
rsource "Kconfig.watchdog"
rsource "Kconfig.home_assistant"
```

## Kconfig.home_assistant
```kconfig
menuconfig MY_MODULE_BASE_HOME_ASSISTANT
	bool "Home Assistant support"

	select MY_MODULE_BASE_OPENTHREAD
	select MY_MODULE_BASE_UID

	select DNS_RESOLVER
	select EVENTS
	select JSON_LIBRARY
	select MQTT_LIB
	select NEWLIB_LIBC_FLOAT_PRINTF
	select POSIX_API

	select NET_TCP

if MY_MODULE_BASE_HOME_ASSISTANT

# DNS default overrides
config DNS_RESOLVER_ADDITIONAL_BUF_CTR
	default 5

config DNS_RESOLVER_ADDITIONAL_QUERIES
	default 2

# MQTT default overrides
config MQTT_KEEPALIVE
	default 600


config MY_MODULE_BASE_HA_DEVICE_NAME
	string "Device name"

choice MY_MODULE_BASE_HA_DEVICE_TYPE
	bool "Device type"
	help
	  Used to set the MQTT base path.
	default MY_MODULE_BASE_HA_DEV_TYPE_AIR_QUALITY

config MY_MODULE_BASE_HA_DEV_TYPE_AIR_QUALITY
	bool "Air Quality device"

config MY_MODULE_BASE_HA_DEV_TYPE_ACTION_BUTTON
	bool "Button device"

config MY_MODULE_BASE_HA_DEV_TYPE_LEAK_DETECTOR
	bool "Leak detector"

config MY_MODULE_BASE_HA_DEV_TYPE_POWER_STATION
	bool "Power Station"
endchoice

config MY_MODULE_BASE_HA_USE_TEST_DISCOVERY_TOPIC
	bool "Use the test discovery topic"
	help
	  Use the test discovery topic.

config MY_MODULE_BASE_HA_MQTT_SERVER_HOSTNAME
	string "MQTT server hostname"
	help
	  Hostname of MQTT server.

config MY_MODULE_BASE_HA_MQTT_SERVER_ADDR
	string "MQTT server address"
	help
	  MQTT server address.

config MY_MODULE_BASE_HA_MQTT_SERVER_PORT
	int "MQTT server port number"
	default 1883
	help
	  MQTT server port number.

config MY_MODULE_BASE_HA_MQTT_BUFFER_SIZE
	int "MQTT RX/TX buffer size"
	default 1024
	help
	  MQTT RX/TX buffer size.

config MY_MODULE_BASE_HA_MQTT_RECEIVE_THREAD_STACK_SIZE
	int "MQTT receive thread stack size"
	default 2048
	help
	  MQTT receive thread stack size.

config MY_MODULE_BASE_HA_OT_LATENCY_THREAD_STACK_SIZE
	int "OpenThread latency thread stack size"
	default 2048
	help
	  OpenThread latency thread stack size.

endif # MY_MODULE_BASE_HOME_ASSISTANT
```

## Kconfig.openthread
```kconfig
menuconfig MY_MODULE_BASE_OPENTHREAD
	bool "Openthread management support"
	select FPU
	select OPENTHREAD_SLAAC
	select NETWORKING
	select NET_L2_OPENTHREAD
	select NET_LOG

if MY_MODULE_BASE_OPENTHREAD

config MY_MODULE_BASE_OT_LATENCY_THREAD_STACK_SIZE
	int "OpenThread latency thread stack size"
	default 2048
	depends on OPENTHREAD_MTD_SED
	help
	  OpenThread latency thread stack size.

config OPENTHREAD_POLL_PERIOD
	default 716000
	depends on OPENTHREAD_MTD_SED

config SYSTEM_WORKQUEUE_STACK_SIZE
	default 2048

config NET_TCP_ISN_RFC6528
	default n

config NET_BUF_TX_COUNT
	default 64

endif # MY_MODULE_BASE_OPENTHREAD
```

## Kconfig.watchdog
```kconfig
menuconfig MY_MODULE_BASE_WATCHDOG
	bool "Watchdog support"
	select WATCHDOG

if MY_MODULE_BASE_WATCHDOG

config MY_MODULE_BASE_WATCHDOG_TIMEOUT_SEC
	int "Watchdog timeout (sec)"
	default 180
	help
	  Watchdog timeout in seconds.

endif # MY_MODULE_BASE_WATCHDOG
```
